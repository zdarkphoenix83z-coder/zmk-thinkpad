/ {
    chosen {
        zmk,kscan = &kscan0;
    };
};

&kscan0 {
    compatible = "zmk,kscan-gpio-matrix";

    diode-direction = "col2row";

    row-gpios = <
        &gpio0 2 GPIO_ACTIVE_LOW
        &gpio0 29 GPIO_ACTIVE_LOW
        &gpio0 31 GPIO_ACTIVE_LOW
        &gpio1 15 GPIO_ACTIVE_LOW
        &gpio1 13 GPIO_ACTIVE_LOW
        &gpio0 17 GPIO_ACTIVE_LOW
        &gpio1 11 GPIO_ACTIVE_LOW
        &gpio1 0 GPIO_ACTIVE_LOW
        &gpio1 4 GPIO_ACTIVE_LOW
    >;

    col-gpios = <
        &gpio0 20 GPIO_ACTIVE_LOW
        &gpio0 22 GPIO_ACTIVE_LOW
        &gpio0 10 GPIO_ACTIVE_LOW
        &gpio1 7 GPIO_ACTIVE_LOW
        &gpio1 1 GPIO_ACTIVE_LOW
        &gpio0 11 GPIO_ACTIVE_LOW
        &gpio0 8 GPIO_ACTIVE_LOW
        &gpio0 6 GPIO_ACTIVE_LOW
        &gpio0 9 GPIO_ACTIVE_LOW
    >;
};
